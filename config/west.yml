## config/west.yml
```yaml
manifest:
  remotes:
    - name: zmkfirmware
#      url-base: https://github.com/LOWPROKB
      url-base: https://github.com/zmkfirmware
#    - name: petejohanson
#      url-base: https://github.com/petejohanson
    - name: caksoylar
      url-base: https://github.com/caksoylar

  projects:
    - name: zmk
#      remote: zmkfirmware
#      revision: Board-Corne-ish-Zen-dedicated-work-queue
      remote: caksoylar
      revision: caksoylar/zen-v1+v2  # custom branch name
      import: app/west.yml
  self:
    path: config
```
